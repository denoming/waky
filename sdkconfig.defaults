## sdkconfig.defaults
```kconfig
# Disable color output (wrong output colors sometimes)
CONFIG_LOG_COLORS=n

# Configure ESP32 CPU frequency
CONFIG_ESP_DEFAULT_CPU_FREQ_MHZ_240=y

# Configure ESP32 Tool
CONFIG_ESPTOOLPY_FLASHFREQ_80M=y
CONFIG_ESPTOOLPY_FLASHMODE_QIO=y
CONFIG_ESPTOOLPY_FLASHSIZE_4MB=y

# Increase FreeRTOS clock frequency
CONFIG_FREERTOS_HZ=1000

# Disable task watchdog by default (suppress warnings due to recognizing)
CONFIG_ESP_TASK_WDT_EN=n

# Configure compiler optimization (reduce the binary size)
CONFIG_COMPILER_OPTIMIZATION_SIZE=y
CONFIG_COMPILER_OPTIMIZATION_ASSERTIONS_SILENT=y

# Disable IPv6 (reduce the binary size)
CONFIG_LWIP_IPV6=n
```

## src/Kconfig.projbuild
```kconfig
menu "Waky configuration"
    menu "Backend"
        config WAKY_BACKEND_HOST
            string "Server hostname"
            default "api.backend.com"
            help
                The hostname (IP address) of server to send recorded audio

        config WAKY_BACKEND_PORT
            int "Server TCP/IP port"
            default 8000
            help
                The port number of HTTP server to send recorded audio

        config WAKY_BACKEND_PATH
            string "Target path"
            default "/speech"
            help
                The target path to send recorded audio

        config WAKY_BACKEND_TIMEOUT
            int "Request timeout"
            default 5000
            range 1000 8000
            help
                The send recorded audio timeout

         config WAKY_BACKEND_CHUNK_SIZE
            int "Chunk size"
            default 1000
            range 500 3000
            help
                The send recorded audio chunk size
    endmenu # Backend

    menu "Memory pool"
        config WAKY_MEMPOOL_BUFFER_SIZE
            int "Memory pool buffer size"
            default 16000
            help
                The memory pool buffer size in bytes (correspond to sample rate)

        config WAKY_MEMPOOL_BUFFER_COUNT
            int "Memory pool count of buffers"
            default 3
            range 1 3
            help
                The memory pool buffer count
    endmenu # Memory pool

    menu "Wake word detection"
        config WAKY_WWD_WINDOW_SIZE
            int "WWD window size"
            default 320
            help
                The size of window to calculate the spectrogram
        
        config WAKY_WWD_STEP_SIZE
            int "WWD step size"
            default 160
            help
                The size of step to move spectrogram calculation window

        config WAKY_WWD_POOLING_SIZE
            int "WWD pooling size"
            default 6
            help
                The pooling size of spectrogram calculation
    endmenu # Wake word detection

    menu "Periphery"
        config WAKY_I2S_MIC_SCK
            int "I2S SCK pin number"
            default 26
            range 0 39
            help
                The pin number of I2S microphone signal clock line

        config WAKY_I2S_MIC_WS
            int "I2S WS pin number"
            default 22
            range 0 39
            help
                The pin number of I2S microphone word select line

        config WAKY_I2S_MIC_SD
            int "I2S SD pin number"
            default 21
            range 0 39
            help
                The pin number of I2S microphone serial data line
    endmenu # Periphery

    # WiFi menu
    menu "WiFi options"
        config WAKY_WIFI_SSID
            string "WiFi SSID"
            default "myssid"
            help
                SSID (network name) to connect to.

        config WAKY_WIFI_PASSWORD
            string "WiFi Password"
            default "mypassword"
            help
                WiFi password (WPA or WPA2) to use.

        choice WAKY_WIFI_SAE_MODE
            prompt "WPA3 SAE mode selection"
            default WAKY_WIFI_WPA3_SAE_PWE_BOTH
            help
                Select mode for SAE as Hunt and Peck, H2E or both.
            config WAKY_WIFI_WPA3_SAE_PWE_HUNT_AND_PECK
                bool "HUNT AND PECK"
            config WAKY_WIFI_WPA3_SAE_PWE_HASH_TO_ELEMENT
                bool "H2E"
            config WAKY_WIFI_WPA3_SAE_PWE_BOTH
                bool "BOTH"
        endchoice

        config WAKY_WIFI_PW_ID
            string "PASSWORD IDENTIFIER"
            depends on  WAKY_WIFI_WPA3_SAE_PWE_HASH_TO_ELEMENT || WAKY_WIFI_WPA3_SAE_PWE_BOTH
            default ""
            help
                password identifier for SAE H2E

        config WAKY_MAXIMUM_RETRY
            int "Maximum retry"
            default 5
            help
                Set the Maximum retry to avoid station reconnecting to the AP unlimited when the AP is really inexistent.

        choice WAKY_WIFI_SCAN_AUTH_MODE_THRESHOLD
            prompt "WiFi Scan auth mode threshold"
            default WAKY_WIFI_AUTH_WPA2_PSK
            help
                The weakest authmode to accept in the scan mode.
                This value defaults to ESP_WIFI_AUTH_WPA2_PSK incase password is present and ESP_WIFI_AUTH_OPEN is used.
                Please select ESP_WIFI_AUTH_WEP/ESP_WIFI_AUTH_WPA_PSK incase AP is operating in WEP/WPA mode.

            config WAKY_WIFI_AUTH_OPEN
                bool "OPEN"
            config WAKY_WIFI_AUTH_WEP
                bool "WEP"
            config WAKY_WIFI_AUTH_WPA_PSK
                bool "WPA PSK"
            config WAKY_WIFI_AUTH_WPA2_PSK
                bool "WPA2 PSK"
            config WAKY_WIFI_AUTH_WPA_WPA2_PSK
                bool "WPA/WPA2 PSK"
            config WAKY_WIFI_AUTH_WPA3_PSK
                bool "WPA3 PSK"
            config WAKY_WIFI_AUTH_WPA2_WPA3_PSK
                bool "WPA2/WPA3 PSK"
            config WAKY_WIFI_AUTH_WAPI_PSK
                bool "WAPI PSK"
        endchoice
    endmenu # WiFi menu
endmenu
```
